/*
 * 此文件为链接文件，目的是将多个.O文件合并为一个可执行文件
 * 用于链接编译过后的文件之间的变量与方法
 */

/* 规定链接的入口为entry.S的_entry方法 */
ENTRY( _entry )
SECTIONS{
    /* 限定_entry的起始位置为0x80000000 */
    . = 0x80000000;

    /* 将代码片链接为一个代码 */
    .text : {
        *(.text)
        /* 保持字节对齐, 在任意操作之后都应当保持校验 */
        . = ALIGN(8);
        _t = .;

    }
}
